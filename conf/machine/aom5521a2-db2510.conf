## conf/machine/aom5521a2-db2510.conf
```bitbake
MACHINEOVERRIDES =. "aom5521:"

require conf/machine/imx95-19x19-lpddr5-evk.conf

KERNEL_DEVICETREE_BASENAME = "${MACHINE}"

EVK_KERNEL_DEVICETREES := "${KERNEL_DEVICETREE}"
KERNEL_DEVICETREE:remove = "${EVK_KERNEL_DEVICETREES}"
KERNEL_DEVICETREE:append = " \
   ./freescale/${KERNEL_DEVICETREE_BASENAME}.dtb \
"

IMX_SOC_REV:${MACHINE} = "B0"
OEI_CONFIGS = "ddr tcm"
OEI_DDR_CONFIG_ECC = ""
```

## conf/machine/ecu150a1.conf
```bitbake
MACHINEOVERRIDES =. "ecu150a1:"

require conf/machine/imx8mq-common.inc

DISTRO_FEATURES:remove = "wayland x11"
IMAGE_FEATURES:remove = "splash"
```
